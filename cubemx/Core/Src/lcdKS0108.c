/*! *******************************************************************************************************
* Copyright (c) 2023 K. Hugyik
*
* All rights reserved
*
* \file lcdKS0108.c
*
* \brief Functions that handle the display on the user interface panel
*
* \author K. Hugyik
*
**********************************************************************************************************/

//--------------------------------------------------------------------------------------------------------/
// Include files
//--------------------------------------------------------------------------------------------------------/
#include "main.h"
#include "lcdKS0108.h"
#include "string.h"
#include "stm32f1xx_ll_gpio.h"

//--------------------------------------------------------------------------------------------------------/
// Definitions
//--------------------------------------------------------------------------------------------------------/
#define LCD_SIZE_X	(128u)
#define LCD_SIZE_Y	(64u)

#define LCD_RW_PORT	LCD_RW_GPIO_Port	//!< 
#define LCD_RW_PIN	LCD_RW_Pin	//!< 

#define LCD_DI_PORT	LCD_DI_GPIO_Port	//!< 
#define LCD_DI_PIN	LCD_DI_Pin	//!< 

#define LCD_E_PORT	LCD_E_GPIO_Port	//!< 
#define LCD_E_PIN	LCD_E_Pin	//!< 

#define LCD_RST_PORT	LCD_RST_GPIO_Port	//!< 
#define LCD_RST_PIN	LCD_RST_Pin	//!< 

#define LCD_CS1_PORT	LCD_CS1_GPIO_Port	//!< 
#define LCD_CS1_PIN	LCD_CS1_Pin	//!< 

#define LCD_CS2_PORT	LCD_CS2_GPIO_Port	//!< 
#define LCD_CS2_PIN	LCD_CS2_Pin	//!< 

//szerencsere minden LCD lab a GPIOB-n van mert az 5V tolerans
#define LCD_DB_PORT	LCD_D0_GPIO_Port	//!<
#define LCD_DB_PINS	LCD_D0_Pin | LCD_D1_Pin | LCD_D2_Pin | LCD_D3_Pin | LCD_D4_Pin | LCD_D5_Pin | LCD_D6_Pin | LCD_D7_Pin //!< 


//--------------------------------------------------------------------------------------------------------/
// Global variables
//--------------------------------------------------------------------------------------------------------/

//! \brief Frame Buffer
uint8_t gau8LCDFrameBuffer[ (LCD_SIZE_X * LCD_SIZE_Y)/8u ] = {0x00};

//--------------------------------------------------------------------------------------------------------/
// Constants
//--------------------------------------------------------------------------------------------------------/

//! \brief Bit-map data of a 8x8 pixels font
const uint8_t cau8Font8x8[2048] = 
{
	0x00, 0x00, 0x00, 0x00, 0x00, 0x00, 0x00, 0x00, 
	0x7e, 0x81, 0xa5, 0x81, 0xbd, 0x99, 0x81, 0x7e, 
	0x7e, 0xff, 0xdb, 0xff, 0xc3, 0xe7, 0xff, 0x7e, 
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	0x00, 0x00, 0x00, 0x00, 0x00, 0x00, 0x00, 0x00
};

//--------------------------------------------------------------------------------------------------------/
// Static functions
//--------------------------------------------------------------------------------------------------------/

//this should be a macro
/*! *******************************************************************
 * \brief Shifts data/instructions for desired display config
 * \param u8Value The data/instruction
*********************************************************************/
static uint32_t u8Data2u32DataPins(uint8_t u8Value) {
	// mivel a pinkiosztas most ez:
	// 15 14 13 12 11 10 09 08 07 06 05 04 03 02 01 00
	// D7 D6 D5 D4 D3 D2 D1 D0 -- -- -- -- -- -- -- --
	// ezert eleg 8-al felshiftelni
	return (((uint32_t)u8Value) << 8u);
	// de pl ha ez lenne:
	// 15 14 13 12 11 10 09 08 07 06 05 04 03 02 01 00
	// D7 D6 D5 D4 -- -- -- -- D3 D2 D1 D0 -- -- -- --
	// akkor igy lenne:
	// return ((((uint32_t)u8Value & 0x00F0) << 8) | (((uint32_t)u8Value & 0x000F) << 4));
}

/*! *******************************************************************
 * \brief Set GPIO Pin state
 * \param GPIOx The GPIO Port
 * \param PinMask Mask to select the pin
 * \param u8Value The desired state
*********************************************************************/
static void GPIO_WritePin(GPIO_TypeDef *GPIOx, uint32_t PinMask, uint8_t u8Value) {
	if(u8Value == GPIO_PIN_SET) {
		LL_GPIO_SetOutputPin(GPIOx, PinMask);
	} else {
		LL_GPIO_ResetOutputPin(GPIOx, PinMask);
	}
}

/*! *******************************************************************
 * \brief Sends instruction or data to the LCD
 * \param bInstruction Boolean for whether it is instruction or data
 * \param u8Value The value to be sent
 * \param u8Controller The controller where the writing should go
*********************************************************************/
static void DISPLAY_RawWrite(bool bInstruction, uint8_t u8Value, uint8_t u8Controller) {
	uint32_t u32DataPins;
	
	// Controller (half-screen) select lines
	// idk whether this is intended behaviour or not but setting u8Controller to 3 selects both
	// this behaviour is not used in the rest of the code
	GPIO_WritePin(LCD_CS1_PORT, LCD_CS1_PIN, (0 != (u8Controller&0x01) ? GPIO_PIN_RESET : GPIO_PIN_SET));
	GPIO_WritePin(LCD_CS2_PORT, LCD_CS2_PIN, (0 != (u8Controller&0x02) ? GPIO_PIN_RESET : GPIO_PIN_SET));
	
	// Set DI depending on the parameters
	GPIO_WritePin(LCD_DI_PORT, LCD_DI_PIN, (bInstruction ? GPIO_PIN_RESET : GPIO_PIN_SET));
	
	// Set RW -- write
	GPIO_WritePin(LCD_RW_PORT, LCD_RW_PIN, GPIO_PIN_RESET);
		
	// Set DB0...DB7
	u32DataPins = u8Data2u32DataPins(u8Value);
	LL_GPIO_SetOutputPin(LCD_DB_PORT, u32DataPins << GPIO_PIN_MASK_POS);
	u32DataPins = u8Data2u32DataPins(~u8Value);
	LL_GPIO_ResetOutputPin(LCD_DB_PORT, u32DataPins << GPIO_PIN_MASK_POS);
	
	// Set E -- default state is 0
	GPIO_WritePin(LCD_E_PORT, LCD_E_PIN, GPIO_PIN_SET);

	// Wait for 1 -- 1.2 usec
	for(volatile uint32_t i = 0; i < 1; i++);	//FIXME: make proper delay function!
	
	// Rising edge of E latches data to the LCD controller
	GPIO_WritePin(LCD_E_PORT, LCD_E_PIN, GPIO_PIN_RESET);

	// Wait for 1 -- 1.2 usec
	for(volatile uint32_t i = 0; i < 1; i++);	//FIXME: is this needed? Also, make proper delay function!
	
	// Set to inactive
	GPIO_WritePin(LCD_CS1_PORT, LCD_CS1_PIN, GPIO_PIN_SET);
	GPIO_WritePin(LCD_CS2_PORT, LCD_CS2_PIN, GPIO_PIN_SET);
}


/*! *******************************************************************
 * \brief Clears the LCD display
*********************************************************************/
static void DISPLAY_Clear(void) {
	for(uint8_t u8HorizontalIndex = 0; u8HorizontalIndex < 8; u8HorizontalIndex++){
		DISPLAY_RawWrite(true, 0xB8 | (u8HorizontalIndex & 0x07), 1);	// set column (1 column = 8 pixel next to each other)
		DISPLAY_RawWrite(true, 0xB8 | (u8HorizontalIndex & 0x07), 2);
		// row by row
		for(uint8_t u8VerticalIndex = 0; u8VerticalIndex < 64; u8VerticalIndex++) {
			DISPLAY_RawWrite(false, 0x00, 1);	// zero for clearing
			DISPLAY_RawWrite(false, 0x00, 2);
			// the row address is automatically incremented
		}
	}
}


/*! *******************************************************************
 * \brief Draws framebuffer to LCD
 * \param au8Array The framebuffer to be drawn
*********************************************************************/
static void DISPLAY_DrawFramebuffer(const uint8_t au8Array[]) {
	uint8_t u8HorizontalIndex, u8VerticalIndex;
	uint16_t u16ArrayIndex = 0;

	for(u8VerticalIndex = 0; u8VerticalIndex < 8; u8VerticalIndex++) {
		DISPLAY_RawWrite(true, 0x40 | 0, 1);	// set Y position to 0
		DISPLAY_RawWrite(true, 0x40 | 0, 2);
		
		DISPLAY_RawWrite(true, 0xB8 | u8VerticalIndex, 2);	// set X page to u8VerticalIndex
		DISPLAY_RawWrite(true, 0xB8 | u8VerticalIndex, 1);
		
		for(u8HorizontalIndex = 0; u8HorizontalIndex < 64; u8HorizontalIndex++) {
			DISPLAY_RawWrite(false, au8Array[u16ArrayIndex], 2);	// first half-screen
			DISPLAY_RawWrite(false, au8Array[64 + u16ArrayIndex++], 1);	// first half-screen
		}
		
		u16ArrayIndex += 64;
	}
}
//--------------------------------------------------------------------------------------------------------/
// Interface functions
//--------------------------------------------------------------------------------------------------------/

/*! *******************************************************************
 * \brief	Draw a pixel at given coordinates
 * \param	u8PosX: coordinate X
 * \param	u8PosY: coordinate Y
 * \param	bIsOn: if true then the pixel is set to be dark; otherwise it becomes transparent
 *********************************************************************/
void DISPLAY_Pixel(uint8_t u8PosX, uint8_t u8PosY, bool bIsOn) {
	// Inside, the LCD display uses a totally different addressing scheme
	// 1 byte corresponds to an 8-pixel tall block
	// So the display assumes that the screen is 84 byte wide and 5 line tall
	if((u8PosX < LCD_SIZE_X) && (u8PosY < LCD_SIZE_Y)) {
		if(bIsOn) {
			gau8LCDFrameBuffer[u8PosX + (LCD_SIZE_X*(u8PosY>>3u))] |= 0x01u<<(u8PosY & 0x07u);
		} else {
			gau8LCDFrameBuffer[u8PosX + (LCD_SIZE_X*(u8PosY>>3u))] &= ~(0x01u<<(u8PosY & 0x07u));
		}
	}
}

/*! *******************************************************************
 * \brief	Draws a line on screen using Bresenham's line algorithm
 * \param	u8X0: origin X coordinate
 * \param	u8Y0: origin Y coordinate
 * \param	u8X1: destination X coordinate
 * \param	u8Y1: destination Y coordinate
 * \param	bIsOn: If true: line will be set; if false: line will be cleared
 *********************************************************************/
void DISPLAY_DrawLine(uint8_t u8X0, uint8_t u8Y0, uint8_t u8X1, uint8_t u8Y1, bool bIsOn) {
	int16_t i16D;
	uint8_t u8dx, u8dy;
	if(u8X0 < u8X1) {
		u8dx = u8X1 - u8X0;
	} else {
		u8dx = u8X0 - u8X1;
		u8X0 = u8X1;
		u8X1 -= u8dx;
	}
	if(u8Y0 < u8Y1) {
		u8dy = u8Y1 - u8Y0;
	} else {
		u8dy = u8Y0 - u8Y1;
		u8Y0 = u8Y1;
		u8Y1 -= u8dy;
	}

	if(u8dx > u8dy) { // low
		u8X1 = (u8X1 < LCD_SIZE_X) ? u8X1 : LCD_SIZE_X;
			i16D = (u8dy * 2) - u8dx;
		for(uint8_t u8i = u8X0, u8j = u8Y0; u8i <= u8X1; u8i++) {
			DISPLAY_Pixel(u8i, u8j, bIsOn);
			if(i16D > 0) {
				u8j++;
				i16D -= u8dx * 2;
			}
			i16D += (u8dy * 2);
		}
	} else { // high
		u8Y1 = (u8Y1 < LCD_SIZE_Y) ? u8Y1 : LCD_SIZE_Y;
			i16D = (u8dx * 2) - u8dy;
		for(uint8_t u8i = u8Y0, u8j = u8X0; u8i <= u8Y1; u8i++) {
			DISPLAY_Pixel(u8j, u8i, bIsOn);
			if(i16D > 0) {
				u8j++;
				i16D -= u8dy * 2;
			}
			i16D += (u8dx * 2);
		}
	}
}

/*! *******************************************************************
 * \brief Initiates the display
 *********************************************************************/
void DISPLAY_Init(void) {
	// Set reset pin high so it is not active
	GPIO_WritePin(LCD_RST_PORT, LCD_RST_PIN, GPIO_PIN_SET);

	// Chip selects: nothing will be selected
	GPIO_WritePin(LCD_CS1_PORT, LCD_CS1_PIN, GPIO_PIN_SET);
	GPIO_WritePin(LCD_CS2_PORT, LCD_CS2_PIN, GPIO_PIN_SET);
	
	// Enable display
	DISPLAY_RawWrite(true, 0x3F, 1);	// both half-screens
	DISPLAY_RawWrite(true, 0x3F, 2);
	
	// The screen starts from the 0 address in the display memory
	DISPLAY_RawWrite(true, 0xC0, 1);	// both half-screens
	DISPLAY_RawWrite(true, 0xC0, 2);
	
	// Clear everything
	DISPLAY_Clear();	
	
	// Hello world
	// maybe init framebuffer with a splashscreen?
	//DISPLAY_DrawFramebuffer(cau8BitMap);
}

 /*! *******************************************************************
 * \brief Cycles the display state
 *********************************************************************/
void DISPLAY_Cycle(void) {
	DISPLAY_DrawFramebuffer(gau8LCDFrameBuffer);
	// clear display buffer
	memset(gau8LCDFrameBuffer, 0x00, 1024);
}

/*! *******************************************************************
 * \brief	Draws a character to the screen
 * \param	u8Char: character to draw (extended ASCII)
 * \param	u8X: character top left corner X coordinate
 * \param	u8Y: character top left corner Y coordinate
 * \param	bIsOn: If true: the pixels will be set; if false: the pixels will be cleared
 *********************************************************************/
void DISPLAY_PrintChar(uint8_t u8Char, uint8_t u8X, uint8_t u8Y, bool bIsOn) {
	for(uint8_t u8IndexX = 0; u8IndexX < 8; u8IndexX++) {
	for(uint8_t u8IndexY = 0; u8IndexY < 8; u8IndexY++) {
		if(((0x80>>u8IndexX) & cau8Font8x8[u8Char*8 + u8IndexY]) != 0) {
			DISPLAY_Pixel(u8X + u8IndexX, u8Y + u8IndexY, bIsOn);
		} else {
			//flip already on pixels
			//probably a bad idea
			//DISPLAY_Pixel(u8X + u8IndexX, u8Y + u8IndexY, true - bIsOn);
		}
	}}
}

/*! *******************************************************************
 * \brief	Draws an entire string to the screen
 * \param	pu8String: string print (extended ASCII)
 * \param	u8X: first character top left corner X coordinate
 * \param	u8Y: first character top left corner Y coordinate
 * \param	bIsOn: If true: the pixels will be set; if false: the pixels will be cleared
 * \return
 *********************************************************************/
void DISPLAY_PrintString(uint8_t* pu8String, uint8_t u8X, uint8_t u8Y, bool bIsOn) {
	uint8_t u8Index = 0;
	// while valid character or less than 16 chars
	// 12 chars dont fit anyway
	while(pu8String[u8Index] != 0 || u8Index > 16) {
		DISPLAY_PrintChar(pu8String[u8Index], u8X + u8Index*8, u8Y, bIsOn);
		u8Index++;
	}
}

//-----------------------------------------------< EOF >--------------------------------------------------/
